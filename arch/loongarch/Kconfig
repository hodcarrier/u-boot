## arch/loongarch/Kconfig
```kconfig
menu "LOONGARCH architecture"
	depends on LOONGARCH

config SYS_ARCH
	default "loongarch"

choice
	prompt "Target select"
	optional

config TARGET_QEMU_VIRT2
	bool "Support QEMU Virt Board"

endchoice

config SYS_ICACHE_OFF
	bool "Do not enable icache"
	help
	  Do not enable instruction cache in U-Boot.

config SPL_SYS_ICACHE_OFF
	bool "Do not enable icache in SPL"
	depends on SPL
	default SYS_ICACHE_OFF
	help
	  Do not enable instruction cache in SPL.

config SYS_DCACHE_OFF
	bool "Do not enable dcache"
	help
	  Do not enable data cache in U-Boot.

config SPL_SYS_DCACHE_OFF
	bool "Do not enable dcache in SPL"
	depends on SPL
	default SYS_DCACHE_OFF
	help
	  Do not enable data cache in SPL.

# board-specific options below
source "board/emulation/qemu-loongarch/Kconfig"

# platform-specific options below
source "arch/loongarch/cpu/ax25/Kconfig"
source "arch/loongarch/cpu/fu540/Kconfig"
source "arch/loongarch/cpu/fu740/Kconfig"
source "arch/loongarch/cpu/generic/Kconfig"

# architecture-specific options below

choice
	prompt "Base ISA"
	default ARCH_LA32I

config ARCH_LA32I
	bool "LA32I"
	select 32BIT
	help
	  Choose this option to target the LA32I base integer instruction set.

config ARCH_LA64I
	bool "LA64I"
	select 64BIT
	select PHYS_64BIT
	help
	  Choose this option to target the LA64I base integer instruction set.

endchoice

choice
	prompt "Code Model"
	default CMODEL_NORMAL

config CMODEL_NORMAL
	bool "medium low code model"
	help
	  U-Boot and its statically defined symbols must lie within a single 2 GiB
	  address range and must lie between absolute addresses -2 GiB and +2 GiB.

config CMODEL_LARGE
	bool "medium any code model"
	help
	  U-Boot and its statically defined symbols must be within any single 2 GiB
	  address range.

endchoice

choice
	prompt "Run Mode"
	default LOONGARCH_MMODE

config LOONGARCH_MMODE
	bool "Machine"
	help
	  Choose this option to build U-Boot for RISC-V M-Mode.

config LOONGARCH_SMODE
	bool "Supervisor"
	help
	  Choose this option to build U-Boot for RISC-V S-Mode.

config LOONGARCH_PLV0
	bool "Privilege LeVel 0"
	help
	  Choose this option to build U-Boot for Loongarch PLV0 Mode.

config LOONGARCH_PLV1
	bool "Privilege LeVel 1"

config LOONGARCH_PLV2
	bool "Privilege LeVel 2"

config LOONGARCH_PLV3
	bool "Privilege LeVel 3"
	  help
	  Choose this option to build U-Boot for Loongarch PLV3 Mode.

endchoice

choice
	prompt "SPL Run Mode"
	default SPL_LOONGARCH_MMODE
	depends on SPL

config SPL_LOONGARCH_MMODE
	bool "Machine"
	help
	  Choose this option to build U-Boot SPL for RISC-V M-Mode.

config SPL_LOONGARCH_SMODE
	bool "Supervisor"
	help
	  Choose this option to build U-Boot SPL for RISC-V S-Mode.

endchoice

config LOONGARCH_ISA_C
	bool "Emit compressed instructions"
	default y
	help
	  Adds "C" to the ISA subsets that the toolchain is allowed to emit
	  when building U-Boot, which results in compressed instructions in the
	  U-Boot binary.

config LOONGARCH_ISA_F
	bool "Standard extension for Single-Precision Floating Point"
	default y
	help
	  Adds "F" to the ISA string passed to the compiler.

config LOONGARCH_ISA_D
	bool "Standard extension for Double-Precision Floating Point"
	depends on LOONGARCH_ISA_F
	default y
	help
	  Adds "D" to the ISA string passed to the compiler and changes the
	  loongarch32 ABI from ilp32 to ilp32d and the loongarch64 ABI from lp64 to
	  lp64d.

config LOONGARCH_ISA_A
	def_bool y

config 32BIT
	bool

config 64BIT
	bool

config DMA_ADDR_T_64BIT
	bool
	default y if 64BIT

config SIFIVE_CLINT
	bool
	depends on LOONGARCH_MMODE
	help
	  The SiFive CLINT block holds memory-mapped control and status registers
	  associated with software and timer interrupts.

config SPL_SIFIVE_CLINT
	bool
	depends on SPL_LOONGARCH_MMODE
	help
	  The SiFive CLINT block holds memory-mapped control and status registers
	  associated with software and timer interrupts.

config SIFIVE_CACHE
	bool
	help
	  This enables the operations to configure SiFive cache

config ANDES_PLICSW
	bool
	depends on LOONGARCH_MMODE || SPL_LOONGARCH_MMODE
	select REGMAP
	select SYSCON
	select SPL_REGMAP if SPL
	select SPL_SYSCON if SPL
	help
	  The Andes PLICSW block holds memory-mapped claim and pending
	  registers associated with software interrupt.

config SMP
	bool "Symmetric Multi-Processing"
	depends on SBI_V01_WIP || !LOONGARCH_SMODE
	help
	  This enables support for systems with more than one CPU. If
	  you say N here, U-Boot will run on single and multiprocessor
	  machines, but will use only one CPU of a multiprocessor
	  machine. If you say Y here, U-Boot will run on many, but not
	  all, single processor machines.

config SPL_SMP
	bool "Symmetric Multi-Processing in SPL"
	depends on SPL && SPL_LOONGARCH_MMODE
	default y
	help
	  This enables support for systems with more than one CPU in SPL.
	  If you say N here, U-Boot SPL will run on single and multiprocessor
	  machines, but will use only one CPU of a multiprocessor
	  machine. If you say Y here, U-Boot SPL will run on many, but not
	  all, single processor machines.

config NR_CPUS
	int "Maximum number of CPUs (2-32)"
	range 2 32
	depends on SMP || SPL_SMP
	default 8
	help
	  On multiprocessor machines, U-Boot sets up a stack for each CPU.
	  Stack memory is pre-allocated. U-Boot must therefore know the
	  maximum number of CPUs that may be present.

config SBI
	bool
	default y if LOONGARCH_SMODE || SPL_LOONGARCH_SMODE

choice
	prompt "SBI support"
	default SBI_V02_WIP

config SBI_V01_WIP
	bool "SBI v0.1 support"
	depends on SBI
	help
	  This config allows kernel to use SBI v0.1 APIs. This will be
	  deprecated in future once legacy M-mode software are no longer in use.

config SBI_V02_WIP
	bool "SBI v0.2 or later support"
	depends on SBI
	help
	  The SBI specification introduced the concept of extensions in version
	  v0.2. With this configuration option U-Boot can detect and use SBI
	  extensions. With the HSM extension introduced in SBI 0.2, only a
	  single hart needs to boot and enter the operating system. The booting
	  hart can bring up secondary harts one by one afterwards.

	  Choose this option if OpenSBI release v0.7 or above is used together
	  with U-Boot.

endchoice

config SBI_IPI
	bool
	depends on SBI
	default y if LOONGARCH_SMODE || SPL_LOONGARCH_SMODE
	depends on SMP

config XIP
	bool "XIP mode"
	help
	  XIP (eXecute In Place) is a method for executing code directly
	  from a NOR flash memory without copying the code to ram.
	  Say yes here if U-Boot boots from flash directly.

config SPL_XIP
	bool "Enable XIP mode for SPL"
	help
	  If SPL starts in read-only memory (XIP for example) then we shouldn't
	  rely on lock variables (for example hart_lottery and available_harts_lock),
	  this affects only SPL, other stages should proceed as non-XIP.

config AVAILABLE_HARTS
	bool "Send IPI by available harts"
	default y
	help
	  By default, IPI sending mechanism will depend on available_harts.
	  If disable this, it will send IPI by CPUs node numbers of device tree.

config SHOW_REGS
	bool "Show registers on unhandled exception"

config LOONGARCH_PRIV_1_9
	bool "Use version 1.9 of the RISC-V priviledged specification"
	help
	  Older versions of the RISC-V priviledged specification had
	  separate counter enable CSRs for each privilege mode. Writing
	  to the unified mcounteren CSR on a processor implementing the
	  old specification will result in an illegal instruction
	  exception. In addition to counter CSR changes, the way virtual
	  memory is configured was also changed.

config STACK_SIZE_SHIFT
	int
	default 14

config OF_BOARD_FIXUP
	default y if OF_SEPARATE && LOONGARCH_SMODE

menu "Use assembly optimized implementation of memory routines"

config USE_ARCH_MEMCPY
	bool "Use an assembly optimized implementation of memcpy"
	default y
	help
	  Enable the generation of an optimized version of memcpy.
	  Such an implementation may be faster under some conditions
	  but may increase the binary size.

config SPL_USE_ARCH_MEMCPY
	bool "Use an assembly optimized implementation of memcpy for SPL"
	default y if USE_ARCH_MEMCPY
	depends on SPL
	help
	  Enable the generation of an optimized version of memcpy.
	  Such an implementation may be faster under some conditions
	  but may increase the binary size.

config TPL_USE_ARCH_MEMCPY
	bool "Use an assembly optimized implementation of memcpy for TPL"
	default y if USE_ARCH_MEMCPY
	depends on TPL
	help
	  Enable the generation of an optimized version of memcpy.
	  Such an implementation may be faster under some conditions
	  but may increase the binary size.

config USE_ARCH_MEMMOVE
	bool "Use an assembly optimized implementation of memmove"
	default y
	help
	  Enable the generation of an optimized version of memmove.
	  Such an implementation may be faster under some conditions
	  but may increase the binary size.

config SPL_USE_ARCH_MEMMOVE
	bool "Use an assembly optimized implementation of memmove for SPL"
	default y if USE_ARCH_MEMCPY
	depends on SPL
	help
	  Enable the generation of an optimized version of memmove.
	  Such an implementation may be faster under some conditions
	  but may increase the binary size.

config TPL_USE_ARCH_MEMMOVE
	bool "Use an assembly optimized implementation of memmove for TPL"
	default y if USE_ARCH_MEMCPY
	depends on TPL
	help
	  Enable the generation of an optimized version of memmove.
	  Such an implementation may be faster under some conditions
	  but may increase the binary size.

config USE_ARCH_MEMSET
	bool "Use an assembly optimized implementation of memset"
	default y
	help
	  Enable the generation of an optimized version of memset.
	  Such an implementation may be faster under some conditions
	  but may increase the binary size.

config SPL_USE_ARCH_MEMSET
	bool "Use an assembly optimized implementation of memset for SPL"
	default y if USE_ARCH_MEMSET
	depends on SPL
	help
	  Enable the generation of an optimized version of memset.
	  Such an implementation may be faster under some conditions
	  but may increase the binary size.

config TPL_USE_ARCH_MEMSET
	bool "Use an assembly optimized implementation of memset for TPL"
	default y if USE_ARCH_MEMSET
	depends on TPL
	help
	  Enable the generation of an optimized version of memset.
	  Such an implementation may be faster under some conditions
	  but may increase the binary size.

endmenu

endmenu
```

## arch/loongarch/cpu/ax25/Kconfig
```kconfig
config LOONGARCH_NDS
	bool
	select ARCH_EARLY_INIT_R
	imply CPU
	imply CPU_LOONGARCH
	imply LOONGARCH_TIMER if (LOONGARCH_SMODE || SPL_LOONGARCH_SMODE)
	imply ANDES_PLICSW if (LOONGARCH_MMODE || SPL_LOONGARCH_MMODE)
	imply ANDES_PLMT_TIMER if (LOONGARCH_MMODE || SPL_LOONGARCH_MMODE)
	imply SPL_CPU
	imply SPL_OPENSBI
	imply SPL_LOAD_FIT
	help
	  Run U-Boot on AndeStar V5 platforms and use some specific features
	  which are provided by Andes Technology AndeStar V5 families.

if LOONGARCH_NDS

config LOONGARCH_NDS_CACHE
	bool "AndeStar V5 families specific cache support"
	depends on LOONGARCH_MMODE || SPL_LOONGARCH_MMODE
	help
	  Provide Andes Technology AndeStar V5 families specific cache support.

endif
```

## arch/loongarch/cpu/generic/Kconfig
```kconfig
# SPDX-License-Identifier: GPL-2.0+
#
# Copyright (C) 2018, Bin Meng <bmeng.cn@gmail.com>

config GENERIC_LOONGARCH
	bool
	select BINMAN if SPL
	select ARCH_EARLY_INIT_R
	imply CPU
	imply CPU_LOONGARCH
	imply LOONGARCH_TIMER if (LOONGARCH_SMODE || SPL_LOONGARCH_SMODE)
	imply SIFIVE_CLINT if LOONGARCH_MMODE
	imply SPL_SIFIVE_CLINT if SPL_LOONGARCH_MMODE
	imply CMD_CPU
	imply SPL_CPU
	imply SPL_OPENSBI
	imply SPL_LOAD_FIT
```

## arch/mips/mach-lsmips/Kconfig
```kconfig
menu "Loongson MIPS platforms"
	depends on ARCH_LSMIPS

config SYS_MALLOC_F_LEN
	default 0x1000

config SYS_SOC
	default "ls1c300" if SOC_LS1C300

config SYS_DCACHE_SIZE
	default 16384

config SYS_DCACHE_LINE_SIZE
	default 32

config SYS_ICACHE_SIZE
	default 16384

config SYS_ICACHE_LINE_SIZE
	default 32

config SYS_TEXT_BASE
	default 0xbfc00000 if !SPL
	default 0x80200000 if SPL

config SPL_TEXT_BASE
	default 0xbfc00000

config SPL_PAYLOAD
	default "u-boot-lzma.img" if SPL_LZMA

config BUILD_TARGET
	default "u-boot-with-spl.bin" if SPL
	default "u-boot.bin" if !SPL

choice
	prompt "Loongson MIPS SoC select"

config SOC_LS1C300
	bool "LS1C300"
	select CLK_CCF
	select SPL_SEPARATE_BSS if SPL
	select SPL_INIT_STACK_WITHOUT_MALLOC_F if SPL
	select SPL_LOADER_SUPPORT if SPL
	select SPL_OF_CONTROL if SPL_DM
	select SPL_SIMPLE_BUS if SPL_DM
	select SPL_DM_SERIAL if SPL_DM
	select SPL_CLK if SPL_DM && SPL_SERIAL
	select SPL_SYSRESET if SPL_DM
	select SPL_OF_LIBFDT if SPL_OF_CONTROL
	help
	  This supports Loongson LS1C300

endchoice

choice
	prompt "Board select"

config BOARD_LS1C300
	bool "Loongson LS1C300 Eval"
	depends on SOC_LS1C300
	help
	  ls1c300-eval board has a LS1C300 SoC with 64MiB of SDRAM
	  and 512KiB of flash (SPI NOR) and additional NAND storage.

endchoice

config CONS_PIN
	int "pin group used in uart"
	default 0
	help
	  Select pin group connected to UART for your board.

source "board/loongson/ls1c300-eval/Kconfig"

endmenu
```

## board/loongson/ls1c300-eval/Kconfig
```kconfig
if BOARD_LS1C300

config SYS_BOARD
	default "ls1c300-eval"

config SYS_VENDOR
	default "loongson"

config SYS_CONFIG_NAME
	default "ls1c300"

endif
```

## configs/ls1c300_defconfig
```kconfig
CONFIG_MIPS=y
CONFIG_SKIP_LOWLEVEL_INIT=y
CONFIG_SYS_MALLOC_F_LEN=0x40000
CONFIG_SPL_LIBCOMMON_SUPPORT=y
CONFIG_SPL_LIBGENERIC_SUPPORT=y
CONFIG_NR_DRAM_BANKS=1
CONFIG_ENV_SIZE=0x1000
CONFIG_DEFAULT_DEVICE_TREE="ls1c300-eval"
CONFIG_DM_RESET=y
CONFIG_SPL_SERIAL=y
CONFIG_SPL_SIZE_LIMIT=0x100000
CONFIG_SPL=y
CONFIG_SYS_LOAD_ADDR=0x80010000
CONFIG_ARCH_LSMIPS=y
CONFIG_SPL_PAYLOAD="u-boot.img"
CONFIG_ROM_EXCEPTION_VECTORS=y
CONFIG_RESTORE_EXCEPTION_VECTOR_BASE=y
CONFIG_MIPS_BOOT_FDT=y
CONFIG_FIT=y
# CONFIG_ARCH_FIXUP_FDT_MEMORY is not set
CONFIG_LOGLEVEL=9
CONFIG_DISPLAY_CPUINFO=y
CONFIG_DISPLAY_BOARDINFO_LATE=y
CONFIG_SPL_MAX_SIZE=0x10000
CONFIG_SPL_PAD_TO=0
CONFIG_SPL_BSS_START_ADDR=0x80010000
CONFIG_SPL_BSS_MAX_SIZE=0x10000
CONFIG_SPL_LEGACY_IMAGE_CRC_CHECK=y
CONFIG_SPL_SYS_MALLOC_SIMPLE=y
CONFIG_SPL_NOR_SUPPORT=y
# CONFIG_CMD_ELF is not set
# CONFIG_CMD_XIMG is not set
# CONFIG_CMD_CRC32 is not set
CONFIG_CMD_CLK=y
# CONFIG_CMD_LOADS is not set
CONFIG_OF_EMBED=y
CONFIG_SYS_RELOC_GD_ENV_ADDR=y
# CONFIG_NET is not set
CONFIG_CLK=y
CONFIG_SPL_CLK_CCF=y
# CONFIG_INPUT is not set
# CONFIG_POWER is not set
CONFIG_CONS_INDEX=2
CONFIG_SPL_SYS_NS16550_SERIAL=y
CONFIG_SYS_NS16550_REG_SIZE=-1
CONFIG_SPI=y
CONFIG_SYSRESET=y
CONFIG_SYSRESET_WATCHDOG=y
CONFIG_SYSRESET_WATCHDOG_AUTO=y
CONFIG_WATCHDOG_TIMEOUT_MSECS=3000
CONFIG_WDT_LSMIPS=y
CONFIG_REGEX=y
# CONFIG_GZIP is not set
```

## configs/ls2k0500_defconfig
```kconfig
CONFIG_LOONGARCH=y
CONFIG_TEXT_BASE=0x9000000003000000
CONFIG_SYS_MALLOC_LEN=0x800000
CONFIG_NR_DRAM_BANKS=1
CONFIG_ENV_SIZE=0x20000
CONFIG_DEFAULT_DEVICE_TREE="loongson-ls2k0500-dev"
CONFIG_SPL=y
CONFIG_DEBUG_UART_BASE=0x800000001ff40800
CONFIG_DEBUG_UART_CLOCK=100000000
CONFIG_SYS_CLK_FREQ=1
CONFIG_SYS_LOAD_ADDR=0x80200000
CONFIG_TARGET_QEMU_VIRT2=y
CONFIG_ARCH_LA64I=y
CONFIG_LOONGARCH_SMODE=y
# CONFIG_AVAILABLE_HARTS is not set
CONFIG_OF_BOARD_FIXUP=y
CONFIG_DEBUG_UART=y
CONFIG_DISTRO_DEFAULTS=y
CONFIG_HAS_CUSTOM_SYS_INIT_SP_ADDR=y
CONFIG_CUSTOM_SYS_INIT_SP_ADDR=0x9000000003400000
CONFIG_FIT=y
CONFIG_SPL_LOAD_FIT_ADDRESS=0x80200000
CONFIG_SYS_MONITOR_BASE=0x81200000
CONFIG_BOOTCOMMAND=""
CONFIG_DISPLAY_CPUINFO=y
CONFIG_DISPLAY_BOARDINFO=y
CONFIG_SPL_MAX_SIZE=0x100000
CONFIG_SPL_BSS_START_ADDR=0x84000000
CONFIG_SYS_SPL_MALLOC=y
CONFIG_SYS_CBSIZE=256
CONFIG_SYS_PBSIZE=276
CONFIG_SYS_BOOTM_LEN=0x4000000
# CONFIG_CMD_MII is not set
CONFIG_OF_EMBED=y
CONFIG_SYS_RELOC_GD_ENV_ADDR=y
CONFIG_DM_MTD=y
CONFIG_SYS_MAX_FLASH_BANKS=2
# CONFIG_HTIF_CONSOLE is not set
# CONFIG_SIFIVE_SERIAL is not set
# CONFIG_BINMAN_FDT is not set
```
